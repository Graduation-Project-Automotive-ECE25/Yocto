## meta-adas/conf/distro/adas.conf
```bitbake
# Inherit poky as base distro
require conf/distro/poky.conf

DISTRO = "adas"
DISTRO_NAME = "ADAS distribution"
DISTRO_VERSION = "1.0"

ENABLE_UART = "1"
INHERIT += "rm_work"
INIT_MANAGER = "systemd"

#Enable VC4GRAPHICS
ENABLE_VC4GRAPHICS = "1"

HDMI_GROUP = "2"

# 1080p 60Hz Screen
HDMI_MODE = "87"
```

## raspberrypi4/conf/bblayers.conf
```bitbake
# POKY_BBLAYERS_CONF_VERSION is increased each time build/conf/bblayers.conf
# changes incompatibly
POKY_BBLAYERS_CONF_VERSION = "2"

BBPATH = "${TOPDIR}"
BBFILES ?= ""

BBLAYERS ?= " \
  /home/assem/Desktop/poky/meta \
  /home/assem/Desktop/poky/meta-poky \
  /home/assem/Desktop/poky/meta-yocto-bsp \
  /home/assem/Desktop/poky/meta-raspberrypi \
  /home/assem/Desktop/poky/meta-openembedded/meta-oe \
  /home/assem/Desktop/poky/meta-openembedded/meta-python \
  /home/assem/Desktop/poky/meta-qt6 \
  /home/assem/Desktop/poky/meta-adas \
  "
```
